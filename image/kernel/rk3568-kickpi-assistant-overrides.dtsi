// ============================================================================
//  image/kernel/rk3568-kickpi-assistant-overrides.dtsi
//
//  「这台机器」的板级覆盖（T15-2-3）—— 被 rk3568-kickpi-k1Mini-assistant.dtsi
//  在**最后** include，所以这里的属性覆盖厂商 dtsi 里的同名属性。
//
//  规矩：每一条覆盖都要写清**证据**（板端实测/文件内部自相矛盾/数据手册），
//        否则以后没人敢动它。
// ============================================================================

// ---------------------------------------------------------------------------
//  ① 触摸复位脚：厂商写 PB5，硬件与它自己的 pinctrl 都是 **PB6**
//
//  证据三条（互相印证）：
//    1) 板端 live DT（`dtc -I fs` 导出的**实际运行**设备树，5.10 厂商镜像，
//       触摸是好的）：`goodix_rst_gpio = <0x3e 0x0e 0x00>`；
//       而 `gpio0@fdd60000` 的 phandle 正是 0x3e（reg = 0xfdd60000）。
//       引脚号 0x0e = 14 = **RK_PB6**（PA0..PA7=0..7，PB0..PB7=8..15）。
//    2) 厂商那份 LCD 文件**自己**的 pinctrl 也写的是 PB6：
//         rockchip,pins = <3 RK_PA3 ...>, <0 RK_PB6 RK_FUNC_GPIO &pcfg_pull_none>;
//       → 说明是那句 `goodix_rst_gpio` 属性写错了（应为 PB6），pinctrl 才是对的。
//    3) IRQ 脚两边一致（gpio3 PA3，低有效），只有复位脚这一处不一致。
//
//  不改的后果：复位脚指向 PB5（那根线在板子上不是触摸复位），触摸**起不来**；
//  而 PB6 仍被 pinctrl 复用成 GPIO，两条线的状态互相打架。
// ---------------------------------------------------------------------------
&gt9xx {
	goodix_rst_gpio = <&gpio0 RK_PB6 GPIO_ACTIVE_HIGH>;
};
